## s4/stage3/ja3g_xnu_defconfig
```kconfig
CONFIG_SAMSUNG_JA3G=y
CONFIG_EXYNOS_5410=y
CONFIG_TEXT_BASE=0x50008000
CONFIG_EMBED_XNU=y
CONFIG_XNU_BLOB_LZ4=y
CONFIG_PAYLOAD_ENTRY=0x68001000
CONFIG_RAMDISK_ENTRY=0x51000000
CONFIG_RAMDISK_NO_COPY=y
CONFIG_LOGLEVEL=7
CONFIG_XNU_EMBED_CACHESLICE=n
CONFIG_XNU_PHYS_BASE=0x68000000
CONFIG_XNU_VIRT_BASE=0x80000000
CONFIG_XNU_MEMSIZE=0x38000000
CONFIG_XNU_CACHESLICE_TOP=0xA0000000
CONFIG_XNU_FB_BASE=0x67000000
CONFIG_XNU_FB_WIDTH=1080
CONFIG_XNU_FB_HEIGHT=1920
CONFIG_XNU_CMDLINE="-v keepsyms=1 kprintf=1 debug=0x14e"
CONFIG_SIMPLE_FB=y
CONFIG_LIBFDT=y
CONFIG_FDT_BUF_SIZE=8192
```
